## conf/distro/ynov-master.conf
```bitbake
require conf/distro/poky.conf

#Define name of distribution
DISTRO = "ynov-master"
DISTRO_NAME = "Ynov Master powered by Yocto/OE"

#Define systemd init manager
VIRTUAL-RUNTIME_init_manager = "systemd"
DISTRO_FEATURES_BACKFILL_CONSIDERED = "sysvinit"
VIRTUAL-RUNTIME_initscripts = ""
DISTRO_FEATURES_append = " systemd"

#Reduce space
INHERIT += "rm_work"

#Warp7 settings
KERNEL_MODULE_AUTOLOAD_append = " g_ether"
IMAGE_BOOT_FILES_append = " boot.scr"
```
